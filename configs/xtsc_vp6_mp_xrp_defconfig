## configs/xtsc_vp6_mp_xrp_defconfig
```kconfig
BR2_xtensa=y
BR2_XTENSA_CUSTOM=y
BR2_XTENSA_OVERLAY_FILE="https://github.com/foss-xtensa/xtensa-overlay/raw/ef26a471d03e68dfb16ee19fce6de8abee9307e2/xtensa_D_233L_pif128_LC.tar.gz"
BR2_WGET="wget --passive-ftp -nd -t 3 --no-check-certificate"
BR2_TOOLCHAIN_BUILDROOT_WCHAR=y
BR2_PTHREAD_DEBUG=y
BR2_BINUTILS_VERSION_2_32_X=y
BR2_GCC_VERSION_9_X=y
BR2_TOOLCHAIN_BUILDROOT_CXX=y
BR2_PACKAGE_UTIL_LINUX_LIBUUID=y
BR2_PACKAGE_UTIL_LINUX=y
BR2_LINUX_KERNEL=y
BR2_LINUX_KERNEL_USE_CUSTOM_CONFIG=y
BR2_LINUX_KERNEL_CUSTOM_CONFIG_FILE="$(TOPDIR)/board/xtsc/vp6-mp/vp6_mp_xrp_defconfig"
BR2_LINUX_KERNEL_IMAGE_TARGET_CUSTOM=y
BR2_LINUX_KERNEL_IMAGE_TARGET_NAME="Image"
BR2_LINUX_KERNEL_IMAGE_NAME="Image.elf"
BR2_LINUX_KERNEL_DTS_SUPPORT=y
BR2_LINUX_KERNEL_USE_CUSTOM_DTS=y
BR2_LINUX_KERNEL_CUSTOM_DTS_PATH="$(TOPDIR)/board/xtsc/vp6-mp/vp6_mp_xrp.dts"
BR2_PACKAGE_XRP=y
BR2_PACKAGE_XRP_FIRMWARE=y
BR2_PACKAGE_XRP_FIRMWARE_XTENSA_TOOLS="/opt/xtensa/XtDevTools/install/tools/RI-2019.2-linux/XtensaTools/bin"
BR2_PACKAGE_XRP_FIRMWARE_DSP_CORE_NAME="visionp6_ao"
BR2_PACKAGE_XRP_FIRMWARE_DSP_NUM_CORES=2
BR2_PACKAGE_XRP_FIRMWARE_DSP_LSP_XTSYS="$(TOPDIR)/board/xtsc/vp6-mp/subsys.xld"
BR2_PACKAGE_XRP_FIRMWARE_DSP_LSP="$(@D)/xrp-example/soc/package/cores/DSP_%d/xtensa-elf/lib/sim-stacklocal"
BR2_TARGET_ROOTFS_EXT2=y
BR2_TARGET_ROOTFS_EXT2_4=y
# BR2_TARGET_ROOTFS_TAR is not set
BR2_PACKAGE_HOST_E2TOOLS=y
```

## package/xrp/Config.in
```kconfig
comment "Xtensa Remote Processing needs a Linux kernel to be built"
	depends on !BR2_LINUX_KERNEL

config BR2_PACKAGE_XRP
	bool "XRP"
	depends on BR2_LINUX_KERNEL
	help
	  XRP is the low level Xtensa Remote Processing

config BR2_PACKAGE_XRP_FIRMWARE
	bool "XRP firmware"
	help
	  XRP package contains kernel driver, host userspace library and
	  example code and firmware library and example code.
	  Say 'Y' here to build firmware code.

if BR2_PACKAGE_XRP_FIRMWARE

config BR2_PACKAGE_XRP_FIRMWARE_DSP_NUM_CORES
	int "Number of DSP cores"
	default 2
	help
	  Number of DSP cores served by the XRP driver. A firmware image
	  is built for each controlled DSP core.

config BR2_PACKAGE_XRP_FIRMWARE_DSP_LSP_XTSYS
	string "LSP source"
	default "$(TOPDIR)/board/xtsc/.../subsys.xtsys"
	help
	  Location of the subsystem configuration for LSP generation.

config BR2_PACKAGE_XRP_FIRMWARE_DSP_LSP
	string "LSP name for each core"
	default "$(@D)/xrp-example/soc/package/cores/...(DSP_%d)/xtensa-elf/lib/sim-stacklocal"
	help
	  Printf format string for LSP name for each core. May use %d or
	  similar format placeholder.

endif
```
