## configs/xtsc_mtk_vp6_xrp_defconfig
```kconfig
BR2_xtensa=y
BR2_XTENSA_CUSTOM=y
BR2_XTENSA_OVERLAY_FILE="https://github.com/foss-xtensa/xtensa-overlay/raw/ef26a471d03e68dfb16ee19fce6de8abee9307e2/xtensa_D_233L_pif128_LC.tar.gz"
BR2_WGET="wget --passive-ftp -nd -t 3 --no-check-certificate"
BR2_TOOLCHAIN_BUILDROOT_WCHAR=y
BR2_PTHREAD_DEBUG=y
BR2_GCC_VERSION_7_X=y
BR2_TOOLCHAIN_BUILDROOT_CXX=y
BR2_LINUX_KERNEL=y
BR2_LINUX_KERNEL_USE_CUSTOM_CONFIG=y
BR2_LINUX_KERNEL_CUSTOM_CONFIG_FILE="$(TOPDIR)/board/xtsc/mtk-vp6-xrp/mtk_vp6_xrp_defconfig"
BR2_LINUX_KERNEL_IMAGE_TARGET_CUSTOM=y
BR2_LINUX_KERNEL_IMAGE_TARGET_NAME="Image"
BR2_LINUX_KERNEL_IMAGE_NAME="Image.elf"
BR2_LINUX_KERNEL_DTS_SUPPORT=y
BR2_LINUX_KERNEL_USE_CUSTOM_DTS=y
BR2_LINUX_KERNEL_CUSTOM_DTS_PATH="$(TOPDIR)/board/xtsc/mtk-vp6-xrp/mtk_vp6_xrp.dts"
BR2_PACKAGE_XRP=y
BR2_PACKAGE_XRP_FIRMWARE=y
BR2_PACKAGE_XRP_FIRMWARE_XTENSA_TOOLS="/opt/xtensa/XtDevTools/install/tools/RG-2017.5-linux/XtensaTools/bin"
BR2_PACKAGE_XRP_FIRMWARE_DSP_CORE_NAME="MTK_VP6"
BR2_PACKAGE_XRP_FIRMWARE_DSP_LSP="$(TOPDIR)/board/xtsc/mtk-vp6-xrp/lsp/P6_%d/xtensa-elf/lib/sim-stacklocal"
BR2_TARGET_ROOTFS_EXT2=y
BR2_TARGET_ROOTFS_EXT2_4=y
# BR2_TARGET_ROOTFS_TAR is not set
BR2_PACKAGE_HOST_E2TOOLS=y
```
